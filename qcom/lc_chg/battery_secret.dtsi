&soc {
    acl_slg: acl_slg {
        compatible = "acl,slg2";
        role = "master_secret";
        chip_name = "ACL16_SLG2";
        onewire-gpios = <&tlmm 106 0x0>;
        enable-gpios = <&tlmm 68 0x0>;
        status = "okay";
    };

    maxim_ds28e30: maxim_ds28e30 {
        compatible = "maxim,ds28e30";
        role = "master_secret";
        chip_name = "DS28E30";
        onewire-gpios = <&tlmm 106 0x0>;
        enable-gpios = <&tlmm 68 0x0>;
        status = "okay";
    };
};
