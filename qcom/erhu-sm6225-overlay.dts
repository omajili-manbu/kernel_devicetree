/dts-v1/;
/plugin/;

#include <dt-bindings/interrupt-controller/arm-gic.h>
#include "khaje-idp-nopmi.dtsi"
#include "erhu-sm6225.dtsi"

/ {
	model = "Qualcomm Technologies, Inc. KHAJE IDP nopmi erhu";
	compatible = "qcom,khaje-idp", "qcom,khaje", "qcom,idp";
	qcom,msm-id = <518 0x10000>, <586 0x10000>;
	qcom,board-id = <0x30022 0>;
	qcom,pmic-id = <0x2D 0x0 0x0 0x0>;
};

&soc {
	/*add simtray status*/
	simtray {
		compatible = "xiaomi,simtray-status";
		status-gpio = <&tlmm 88 0x00>;
	};
};