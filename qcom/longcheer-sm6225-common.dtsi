// Add by Longcheer
&usb2_phy0 {
	qcom,param-override-seq-panel = <
			0xa7 0x6c
			0x99 0x70
			0x1e 0x74
			0x03 0x78>;
	qcom,param-override-seq-no-panel = <
			0xa7 0x6c
			0x99 0x70
			0x1e 0x74
			0x03 0x78>;
};

